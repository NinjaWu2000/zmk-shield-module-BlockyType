## boards/shields/BlockyType/Kconfig.shield
```kconfig
config SHIELD_BLOCKYTYPE_LEFT
    def_bool $(shields_list_contains,BlockyType_left)

config SHIELD_BLOCKYTYPE_RIGHT
    def_bool $(shields_list_contains,BlockyType_right)
```

## boards/shields/blockytype/Kconfig.defconfig
```kconfig
if SHIELD_BLOCKYTYPE_RIGHT

    # Name must be less than 16 characters long!
    config ZMK_KEYBOARD_NAME
        default "BlockyType"

    config ZMK_SPLIT_ROLE_CENTRAL
        default y

endif

if SHIELD_BLOCKYTYPE_LEFT
    config ZMK_SPLIT_ROLE_CENTRAL
        default n


endif

if SHIELD_BLOCKYTYPE_LEFT || SHIELD_BLOCKYTYPE_RIGHT

    config ZMK_SPLIT
        default n

endif
```

## boards/shields/blockytype/Kconfig.shield
```kconfig
config SHIELD_BLOCKYTYPE_LEFT
    def_bool $(shields_list_contains,blockytype_left)

config SHIELD_BLOCKYTYPE_RIGHT
    def_bool $(shields_list_contains,blockytype_right)
```

## config/west.yml
```yaml
manifest:
  remotes:
    - name: zmkfirmware
      url-base: https://github.com/zmkfirmware
    - name: urob
      url-base: https://github.com/urob
    - name: joelspadin
      url-base: https://github.com/joelspadin
  projects:
    - name: zmk
      remote: zmkfirmware
      revision: main
      import: app/west.yml
    - name: zmk-helpers
      remote: urob
      revision: main
    - name: zmk-locales
      remote: joelspadin
      revision: main
  self:
    path: config
```
